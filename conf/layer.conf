## conf/layer.conf
```bitbake
# We have a conf and classes directory, add to BBPATH
BBPATH .= ":${LAYERDIR}"

# We have recipes-* directories, add to BBFILES
BBFILES += "${LAYERDIR}/recipes-*/*/*.bb \
            ${LAYERDIR}/recipes-*/*/*.bbappend \
            ${LAYERDIR}/images/*.bb"

BBFILE_COLLECTIONS += "meta-georges"
BBFILE_PATTERN_meta-georges = "^${LAYERDIR}/"
BBFILE_PRIORITY_meta-georges = "6"

LAYERDEPENDS_meta-georges = "core"
LAYERSERIES_COMPAT_meta-georges = "dunfell"
```
